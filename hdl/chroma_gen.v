// chroma_gen.v — NTSC color subcarrier generator (burst + chroma offset)
//
// Phase 2 of Schindler 2.0. Adds 3.579545 MHz subcarrier on the back porch
// (color burst) so the FPGA composite output advances from monochrome to
// chroma-capable. First-light scope target: visible ~9-cycle sine burst on
// the back porch at ±20 IRE, riding on the blanking level.
//
// Output is a SIGNED 11-bit chroma offset that the top-level combiner adds
// to the unsigned luma DAC code (from sample_gen.v) during burst window and
// active video. Sign comes from cosine LUT contents (two's-complement
// signed values, peak ±255 at the LUT level; scaled at runtime by
// BURST_AMPLITUDE / 256 to land at the target IRE level).
//
// NCO architecture: 32-bit phase accumulator increments by PHASE_INCREMENT
// every pixel clock. Top 8 bits index a 256-entry cosine LUT. Phase
// accumulator runs free across lines and frames — burst phase is therefore
// non-coherent with line rate (acceptable for v1 per Schindler playbook
// Ch. 4; coherent mode is a v2 refinement).
//
// Frequency math (cross-referenced in python/encoder/gen_chroma_lut.py):
//   PHASE_INCREMENT = round(2**32 * 3.579545e6 / 54e6) = 284_704_272 (0x10F83E10)
//   Frequency error vs NTSC spec = 0.002 ppm (essentially exact).
//
// Burst placement (per SMPTE 170M, default values match flyer geometry):
//   sync leading edge  = pixel 81   (H_FRONT_PIXELS)
//   sync trailing edge = pixel 335
//   BURST_START_PIXEL  = 368        (sync_leading + 19 subcarrier cycles)
//   BURST_END_PIXEL    = 504        (start + 9 cycles = 136 pixels)
//   active video start = pixel 589  (ACTIVE_START)
//
// Burst amplitude math:
//   NTSC spec: 40 IRE p-p burst on the back porch = ±20 IRE peak
//   DAC scale: 140 IRE end-to-end maps to 1023 codes, so 1 IRE = 7.31 codes
//   ±20 IRE = ±146 DAC codes -> BURST_AMPLITUDE = 146
//
// Active-video chroma is reserved (signal hooks present) but currently
// outputs zero — patterns remain luma-only until chroma_mod logic is added.

`default_nettype none
`timescale 1ns / 1ps

module chroma_gen #(
    parameter integer PIXELS_PER_LINE   = 3435,
    parameter integer BURST_START_PIXEL = 368,
    parameter integer BURST_END_PIXEL   = 504,
    parameter integer BURST_AMPLITUDE   = 146,           // ±20 IRE = 40 IRE p-p
    parameter [31:0]  PHASE_INCREMENT   = 32'h10F83E10   // 3.579545 MHz at 54 MHz
) (
    input  wire              clk,
    input  wire              rst,

    // From vid_timing
    input  wire [11:0]       pixel_count,
    input  wire [9:0]        line_count,
    input  wire              active,

    // Reserved: pattern selector for future active-video chroma patterns.
    // Currently unused — active_chroma is forced to zero until chroma
    // patterns are implemented in a future revision.
    input  wire [2:0]        pattern_sel,

    // Signed chroma offset, summed with luma in top-level combiner
    output reg signed [10:0] chroma_offset
);

    // ------------------------------------------------------------
    // NCO — 32-bit phase accumulator, free-running across the frame
    // ------------------------------------------------------------
    reg [31:0] phase_acc;

    always @(posedge clk) begin
        if (rst) phase_acc <= 32'd0;
        else     phase_acc <= phase_acc + PHASE_INCREMENT;
    end

    wire [7:0] phase_idx = phase_acc[31:24];

    // ------------------------------------------------------------
    // Cosine LUT — 256 entries, signed 10-bit, peak ±255
    // Generated by python/encoder/gen_chroma_lut.py
    // ------------------------------------------------------------
    reg signed [9:0] cos_lut [0:255];

    initial begin
        $readmemh("chroma_lut_cos.hex", cos_lut);
    end

    wire signed [9:0] cos_value = cos_lut[phase_idx];

    // ------------------------------------------------------------
    // Burst amplitude scaling:
    //   burst_signal = (cos_value * BURST_AMPLITUDE) >>> 8
    // With cos_value peak ±255 (signed 10-bit) and BURST_AMPLITUDE = 146,
    // burst_signal peak ≈ ±146 codes ≈ ±20 IRE.
    // Signed 10 × signed 10 = signed 20-bit full product.
    // Arithmetic right-shift 8 preserves sign; truncate to 11-bit signed for
    // chroma_offset (values fit comfortably in signed 11-bit).
    // ------------------------------------------------------------
    wire signed [9:0]  burst_amp_signed = $signed({2'b00, BURST_AMPLITUDE[7:0]});
    wire signed [19:0] burst_full = cos_value * burst_amp_signed;
    wire signed [10:0] burst_signal = burst_full >>> 8;

    // ------------------------------------------------------------
    // Burst window: back-porch region between BURST_START_PIXEL and
    // BURST_END_PIXEL. Always present (every line, including VBI blank
    // lines) because the receiver expects burst on every active-region
    // line for chroma sync. Field-1/field-2 burst phase alternation
    // (Schindler playbook Ch. 5) is deferred to a later revision.
    // ------------------------------------------------------------
    wire in_burst_window = (pixel_count >= BURST_START_PIXEL[11:0]) &&
                           (pixel_count <  BURST_END_PIXEL[11:0]);

    // ------------------------------------------------------------
    // Active-video chroma — placeholder. Currently zero for all patterns;
    // future revisions implement chroma modulation for color bars and
    // single-hue fields keyed off pattern_sel.
    // ------------------------------------------------------------
    wire signed [10:0] active_chroma = 11'sd0;

    // pattern_sel currently unused; declared for forward-compatible wiring.
    // synthesis attribute prevents unused-signal warning during build.
    /* verilator lint_off UNUSED */
    wire [2:0] _unused_pattern_sel = pattern_sel;
    /* verilator lint_on UNUSED */

    // ------------------------------------------------------------
    // Output mux — burst overrides active overrides zero.
    // Registered for clean DAC pin timing (matches sample_gen.v style).
    // ------------------------------------------------------------
    always @(posedge clk) begin
        if (rst)                  chroma_offset <= 11'sd0;
        else if (in_burst_window) chroma_offset <= burst_signal;
        else if (active)          chroma_offset <= active_chroma;
        else                      chroma_offset <= 11'sd0;
    end

endmodule

`default_nettype wire
